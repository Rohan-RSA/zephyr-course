## app/boards/our_board/board.yml
```yaml
board:
  name: our_board
  full_name: Our board using copy/rename method
  vendor: iomico
  socs:
  - name: mcxa156
```

## boards/my_board/board.yml
```yaml
board:
  name: my_board
  full_name: Our board from scratch method
  vendor: iomico
  socs:
  - name: mcxa156
```
