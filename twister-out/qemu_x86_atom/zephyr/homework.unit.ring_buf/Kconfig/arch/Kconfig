## twister-out/qemu_x86_atom/zephyr/homework.unit.ring_buf/Kconfig/arch/Kconfig
```kconfig
# Load Zephyr Arch Kconfig descriptions.
osource "C:/Projects/ZephyrCourses/iomco/deps/zephyr/arch/rx/Kconfig"
osource "C:/Projects/ZephyrCourses/iomco/deps/zephyr/arch/x86/Kconfig"
osource "C:/Projects/ZephyrCourses/iomco/deps/zephyr/arch/xtensa/Kconfig"
osource "C:/Projects/ZephyrCourses/iomco/deps/zephyr/arch/sparc/Kconfig"
osource "C:/Projects/ZephyrCourses/iomco/deps/zephyr/arch/riscv/Kconfig"
osource "C:/Projects/ZephyrCourses/iomco/deps/zephyr/arch/posix/Kconfig"
osource "C:/Projects/ZephyrCourses/iomco/deps/zephyr/arch/mips/Kconfig"
osource "C:/Projects/ZephyrCourses/iomco/deps/zephyr/arch/arm64/Kconfig"
osource "C:/Projects/ZephyrCourses/iomco/deps/zephyr/arch/arm/Kconfig"
osource "C:/Projects/ZephyrCourses/iomco/deps/zephyr/arch/arc/Kconfig"
```

## twister-out/qemu_x86_atom/zephyr/homework.unit.ring_buf/Kconfig/boards/Kconfig.defconfig
```kconfig
# Load Zephyr board defconfig descriptions.
osource "C:/Projects/ZephyrCourses/iomco/deps/zephyr/boards/qemu/x86/Kconfig.defconfig"
```

## twister-out/qemu_x86_atom/zephyr/homework.unit.ring_buf/Kconfig/boards/Kconfig.qemu_x86
```kconfig
# Load board Kconfig descriptions.
osource "C:/Projects/ZephyrCourses/iomco/deps/zephyr/boards/qemu/x86/Kconfig.qemu_x86"
```

## twister-out/qemu_x86_atom/zephyr/homework.unit.ring_buf/Kconfig/soc/Kconfig
```kconfig
# Load Zephyr SoC Kconfig descriptions.
osource "C:/Projects/ZephyrCourses/iomco/deps/zephyr/soc/xlnx/zynqmp/Kconfig"
osource "C:/Projects/ZephyrCourses/iomco/deps/zephyr/soc/xlnx/zynq7000/Kconfig"
osource "C:/Projects/ZephyrCourses/iomco/deps/zephyr/soc/xlnx/versalnet/Kconfig"
osource "C:/Projects/ZephyrCourses/iomco/deps/zephyr/soc/xlnx/versal2/Kconfig"
osource "C:/Projects/ZephyrCourses/iomco/deps/zephyr/soc/xen/Kconfig"
osource "C:/Projects/ZephyrCourses/iomco/deps/zephyr/soc/wch/ch32v/Kconfig"
osource "C:/Projects/ZephyrCourses/iomco/deps/zephyr/soc/ti/simplelink/Kconfig"
osource "C:/Projects/ZephyrCourses/iomco/deps/zephyr/soc/ti/mspm0/Kconfig"
osource "C:/Projects/ZephyrCourses/iomco/deps/zephyr/soc/ti/lm3s6965/Kconfig"
osource "C:/Projects/ZephyrCourses/iomco/deps/zephyr/soc/ti/k3/Kconfig"
osource "C:/Projects/ZephyrCourses/iomco/deps/zephyr/soc/telink/tlsr/Kconfig"
osource "C:/Projects/ZephyrCourses/iomco/deps/zephyr/soc/starfive/jh71xx/Kconfig"
osource "C:/Projects/ZephyrCourses/iomco/deps/zephyr/soc/st/stm32/Kconfig"
osource "C:/Projects/ZephyrCourses/iomco/deps/zephyr/soc/snps/qemu_arc/Kconfig"
osource "C:/Projects/ZephyrCourses/iomco/deps/zephyr/soc/snps/nsim/arc_v/Kconfig"
osource "C:/Projects/ZephyrCourses/iomco/deps/zephyr/soc/snps/nsim/arc_classic/Kconfig"
osource "C:/Projects/ZephyrCourses/iomco/deps/zephyr/soc/snps/hsdk4xd/Kconfig"
osource "C:/Projects/ZephyrCourses/iomco/deps/zephyr/soc/snps/hsdk/Kconfig"
osource "C:/Projects/ZephyrCourses/iomco/deps/zephyr/soc/snps/emsk/Kconfig"
osource "C:/Projects/ZephyrCourses/iomco/deps/zephyr/soc/snps/emsdp/Kconfig"
osource "C:/Projects/ZephyrCourses/iomco/deps/zephyr/soc/snps/arc_iot/Kconfig"
osource "C:/Projects/ZephyrCourses/iomco/deps/zephyr/soc/silabs/Kconfig"
osource "C:/Projects/ZephyrCourses/iomco/deps/zephyr/soc/sifive/sifive_freedom/Kconfig"
osource "C:/Projects/ZephyrCourses/iomco/deps/zephyr/soc/sensry/Kconfig"
osource "C:/Projects/ZephyrCourses/iomco/deps/zephyr/soc/rockchip/Kconfig"
osource "C:/Projects/ZephyrCourses/iomco/deps/zephyr/soc/renode/riscv_virtual/Kconfig"
osource "C:/Projects/ZephyrCourses/iomco/deps/zephyr/soc/renode/cortex_r8_virtual/Kconfig"
osource "C:/Projects/ZephyrCourses/iomco/deps/zephyr/soc/renesas/smartbond/Kconfig"
osource "C:/Projects/ZephyrCourses/iomco/deps/zephyr/soc/renesas/rz/Kconfig"
osource "C:/Projects/ZephyrCourses/iomco/deps/zephyr/soc/renesas/rx/Kconfig"
osource "C:/Projects/ZephyrCourses/iomco/deps/zephyr/soc/renesas/rcar/Kconfig"
osource "C:/Projects/ZephyrCourses/iomco/deps/zephyr/soc/renesas/ra/Kconfig"
osource "C:/Projects/ZephyrCourses/iomco/deps/zephyr/soc/realtek/ec/Kconfig"
osource "C:/Projects/ZephyrCourses/iomco/deps/zephyr/soc/raspberrypi/rpi_pico/Kconfig"
osource "C:/Projects/ZephyrCourses/iomco/deps/zephyr/soc/quicklogic/eos_s3/Kconfig"
osource "C:/Projects/ZephyrCourses/iomco/deps/zephyr/soc/qemu/virt_riscv/Kconfig"
osource "C:/Projects/ZephyrCourses/iomco/deps/zephyr/soc/qemu/malta/Kconfig"
osource "C:/Projects/ZephyrCourses/iomco/deps/zephyr/soc/openisa/rv32m1/Kconfig"
osource "C:/Projects/ZephyrCourses/iomco/deps/zephyr/soc/openhwgroup/cva6/Kconfig"
osource "C:/Projects/ZephyrCourses/iomco/deps/zephyr/soc/oct/osd32mp15x/Kconfig"
osource "C:/Projects/ZephyrCourses/iomco/deps/zephyr/soc/nxp/s32/Kconfig"
osource "C:/Projects/ZephyrCourses/iomco/deps/zephyr/soc/nxp/rw/Kconfig"
osource "C:/Projects/ZephyrCourses/iomco/deps/zephyr/soc/nxp/mcx/Kconfig"
osource "C:/Projects/ZephyrCourses/iomco/deps/zephyr/soc/nxp/lpc/Kconfig"
osource "C:/Projects/ZephyrCourses/iomco/deps/zephyr/soc/nxp/layerscape/Kconfig"
osource "C:/Projects/ZephyrCourses/iomco/deps/zephyr/soc/nxp/kinetis/Kconfig"
osource "C:/Projects/ZephyrCourses/iomco/deps/zephyr/soc/nxp/imxrt/Kconfig"
osource "C:/Projects/ZephyrCourses/iomco/deps/zephyr/soc/nxp/imx/Kconfig"
osource "C:/Projects/ZephyrCourses/iomco/deps/zephyr/soc/nuvoton/numicro/Kconfig"
osource "C:/Projects/ZephyrCourses/iomco/deps/zephyr/soc/nuvoton/numaker/Kconfig"
osource "C:/Projects/ZephyrCourses/iomco/deps/zephyr/soc/nuvoton/npcx/Kconfig"
osource "C:/Projects/ZephyrCourses/iomco/deps/zephyr/soc/nuvoton/npcm/Kconfig"
osource "C:/Projects/ZephyrCourses/iomco/deps/zephyr/soc/nordic/Kconfig"
osource "C:/Projects/ZephyrCourses/iomco/deps/zephyr/soc/neorv32/Kconfig"
osource "C:/Projects/ZephyrCourses/iomco/deps/zephyr/soc/native/inf_clock/Kconfig"
osource "C:/Projects/ZephyrCourses/iomco/deps/zephyr/soc/microchip/sam/Kconfig"
osource "C:/Projects/ZephyrCourses/iomco/deps/zephyr/soc/microchip/miv/Kconfig"
osource "C:/Projects/ZephyrCourses/iomco/deps/zephyr/soc/microchip/mec/Kconfig"
osource "C:/Projects/ZephyrCourses/iomco/deps/zephyr/soc/mediatek/mt8xxx/Kconfig"
osource "C:/Projects/ZephyrCourses/iomco/deps/zephyr/soc/lowrisc/opentitan/Kconfig"
osource "C:/Projects/ZephyrCourses/iomco/deps/zephyr/soc/litex/litex_vexriscv/Kconfig"
osource "C:/Projects/ZephyrCourses/iomco/deps/zephyr/soc/ite/ec/Kconfig"
osource "C:/Projects/ZephyrCourses/iomco/deps/zephyr/soc/intel/raptor_lake/Kconfig"
osource "C:/Projects/ZephyrCourses/iomco/deps/zephyr/soc/intel/lakemont/Kconfig"
osource "C:/Projects/ZephyrCourses/iomco/deps/zephyr/soc/intel/intel_socfpga_std/Kconfig"
osource "C:/Projects/ZephyrCourses/iomco/deps/zephyr/soc/intel/intel_socfpga/Kconfig"
osource "C:/Projects/ZephyrCourses/iomco/deps/zephyr/soc/intel/intel_niosv/Kconfig"
osource "C:/Projects/ZephyrCourses/iomco/deps/zephyr/soc/intel/intel_ish/Kconfig"
osource "C:/Projects/ZephyrCourses/iomco/deps/zephyr/soc/intel/intel_adsp/Kconfig"
osource "C:/Projects/ZephyrCourses/iomco/deps/zephyr/soc/intel/elkhart_lake/Kconfig"
osource "C:/Projects/ZephyrCourses/iomco/deps/zephyr/soc/intel/atom/Kconfig"
osource "C:/Projects/ZephyrCourses/iomco/deps/zephyr/soc/intel/apollo_lake/Kconfig"
osource "C:/Projects/ZephyrCourses/iomco/deps/zephyr/soc/intel/alder_lake/Kconfig"
osource "C:/Projects/ZephyrCourses/iomco/deps/zephyr/soc/infineon/cat3/Kconfig"
osource "C:/Projects/ZephyrCourses/iomco/deps/zephyr/soc/infineon/cat1c/Kconfig"
osource "C:/Projects/ZephyrCourses/iomco/deps/zephyr/soc/infineon/cat1b/Kconfig"
osource "C:/Projects/ZephyrCourses/iomco/deps/zephyr/soc/infineon/cat1a/Kconfig"
osource "C:/Projects/ZephyrCourses/iomco/deps/zephyr/soc/gd/gd32/Kconfig"
osource "C:/Projects/ZephyrCourses/iomco/deps/zephyr/soc/gaisler/leon3/Kconfig"
osource "C:/Projects/ZephyrCourses/iomco/deps/zephyr/soc/gaisler/gr716a/Kconfig"
osource "C:/Projects/ZephyrCourses/iomco/deps/zephyr/soc/espressif/Kconfig"
osource "C:/Projects/ZephyrCourses/iomco/deps/zephyr/soc/ene/kb1200/Kconfig"
osource "C:/Projects/ZephyrCourses/iomco/deps/zephyr/soc/ene/kb106x/Kconfig"
osource "C:/Projects/ZephyrCourses/iomco/deps/zephyr/soc/efinix/sapphire/Kconfig"
osource "C:/Projects/ZephyrCourses/iomco/deps/zephyr/soc/cdns/xtensa_sample_controller/Kconfig"
osource "C:/Projects/ZephyrCourses/iomco/deps/zephyr/soc/cdns/sample_controller32/Kconfig"
osource "C:/Projects/ZephyrCourses/iomco/deps/zephyr/soc/cdns/dc233c/Kconfig"
osource "C:/Projects/ZephyrCourses/iomco/deps/zephyr/soc/brcm/bcmvk/Kconfig"
osource "C:/Projects/ZephyrCourses/iomco/deps/zephyr/soc/brcm/bcm2712/Kconfig"
osource "C:/Projects/ZephyrCourses/iomco/deps/zephyr/soc/brcm/bcm2711/Kconfig"
osource "C:/Projects/ZephyrCourses/iomco/deps/zephyr/soc/bflb/Kconfig"
osource "C:/Projects/ZephyrCourses/iomco/deps/zephyr/soc/atmel/sam0/Kconfig"
osource "C:/Projects/ZephyrCourses/iomco/deps/zephyr/soc/atmel/sam/Kconfig"
osource "C:/Projects/ZephyrCourses/iomco/deps/zephyr/soc/aspeed/Kconfig"
osource "C:/Projects/ZephyrCourses/iomco/deps/zephyr/soc/arm/Kconfig"
osource "C:/Projects/ZephyrCourses/iomco/deps/zephyr/soc/arm/beetle/Kconfig"
osource "C:/Projects/ZephyrCourses/iomco/deps/zephyr/soc/antmicro/myra/Kconfig"
osource "C:/Projects/ZephyrCourses/iomco/deps/zephyr/soc/andestech/Kconfig"
osource "C:/Projects/ZephyrCourses/iomco/deps/zephyr/soc/amd/acp_6_0/Kconfig"
osource "C:/Projects/ZephyrCourses/iomco/deps/zephyr/soc/ambiq/Kconfig"
osource "C:/Projects/ZephyrCourses/iomco/deps/zephyr/soc/aesc/Kconfig"
osource "C:/Projects/ZephyrCourses/iomco/deps/zephyr/soc/adi/max32/Kconfig"
```
